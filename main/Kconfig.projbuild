## main/Kconfig.projbuild
```kconfig
menu "Astronomical Watch"

    config WATCH_DEV_LOGGING
        bool "Development logging across deep sleep"
        default y
        help
            Waits for the USB Serial/JTAG host after each key or power-on wake
            and flushes the console before deep sleep, so that no log line is
            lost while USB re-enumerates. Costs up to about 2 s of awake time
            per such wake. Timer wakes never wait.

    config WATCH_TEST_SETTINGS
        bool "Use these settings, ignore the saved ones (test builds)"
        default n
        help
            The display timeout, always-on, brightness and auto-off options
            below are only the defaults of the settings page; a saved setting
            replaces them. Test builds that need other values (outside the
            page's lists, too) enable this: the saved settings are neither read
            nor written, and changes on the page last until the next sleep.

    config WATCH_DISPLAY_TIMEOUT_S
        int "Display timeout (s)"
        range 5 36000
        default 10
        help
            Active mode ends this long after it started or after the last
            touch, whichever is later; a PWR press ends it at once. The watch
            then shows the always-on face, or powers off without it. The
            settings page offers 5, 10, 20, 30 and 60 s; longer values are
            for test builds (sdkconfig.drain).

    config WATCH_ALWAYS_ON
        bool "Always-on face after active mode"
        default y
        help
            Without it the watch powers off when active mode ends.

    config WATCH_DISPLAY_BRIGHTNESS
        int "Display brightness (%)"
        range 1 100
        default 50
        help
            Panel brightness in active mode (DBV, command 0x51). AMOLED
            current grows with brightness and with the number of lit pixels.
            The settings page offers 20, 50 and 100 %.

    config WATCH_AOD_BRIGHTNESS
        int "Always-on brightness (%)"
        range 1 100
        default 10
        help
            Panel brightness of the always-on face.

    config WATCH_MOTION_CHECK_MIN
        int "Motion check interval in always-on (minutes)"
        range 1 60
        default 10
        help
            The accelerometer is read once per interval (about 0.1 s awake)
            and compared with the reading before. The default 10 min was
            checked on the wrist (docs/hardware.md, QMI8658A section).

    config WATCH_MOTION_OFF_MIN
        int "Power off after no motion for (minutes, 0 = never)"
        range 0 1440
        default 30
        help
            In always-on, the watch powers off when the readings of this many
            minutes (a multiple of the check interval) all stay within the
            no-motion threshold. 0 keeps the face on. The settings page offers
            20, 30 and 60 min and never.

    config WATCH_AOD_IDLE_MODE
        bool "Always-on face in idle mode (8 colours)"
        default y
        help
            Sends Idle Mode On (39h) with the first always-on drawing. Battery
            runs E and F (docs/hardware.md) estimate about 9 mA in always-on
            with it and about 14 mA without it.

    config WATCH_QUIESCE
        bool "Put unused peripherals into their lowest-power state"
        default y
        help
            Touch sleep, panel deep standby, IMU power-down, RTC CLKOUT off,
            unused AXP2101 rails off and AXP2101 IRQs limited to the PWR key,
            once after power-on. Disable only to compare battery drain with the
            default state.

    config WATCH_CODEC_POWER_DOWN
        bool "Power the codecs down (battery test)"
        default n
        depends on WATCH_QUIESCE
        help
            Adds the ES8311/ES7210 power-down of battery run C to the sleep
            preparation. That run drained about ten times more, and so did run I
            with the I2S lines held.

    config WATCH_CODEC_WRITE_MASK
        hex "Codec writes to apply"
        default 0x7F
        range 0x01 0x7F
        depends on WATCH_CODEC_POWER_DOWN
        help
            Bit i applies entry i of the power-down table in Peripherals.cpp:
            bits 0-3 ES8311 0x14, 0x0E, 0x0D, 0x01; bits 4-6 ES7210 0x40,
            0x01, 0x06.

    config WATCH_AXP_MEASURE_OFF_IN_SLEEP
        bool "AXP2101 ADCs and fuel gauge off in deep sleep (battery test)"
        default n
        depends on WATCH_BATTERY_LOG
        help
            Battery run O: every AXP2101 ADC channel (REG30) and the fuel gauge
            (REG18 bit3) are switched off before deep sleep and on again after
            each wake, before the battery is read. Shows how much of the sleep
            drain the AXP2101 measurement circuits take. The gauge percentage
            is not valid in this run.

    config WATCH_SLEEP_DCDC1_MV
        int "DCDC1 (VCC3V3) voltage in deep sleep, mV (battery test, 0 = unchanged)"
        default 0
        range 0 3400
        depends on WATCH_BATTERY_LOG
        help
            Battery run Q: DCDC1 is set to this voltage before deep sleep and back
            to 3300 mV after each wake. A load on VCC3V3 draws less at a lower
            voltage; the AXP2101's own current and the ALDO1 loads (fed from VSYS)
            do not, so the change in the sleep drain shows which side the floor
            is on. 3000 mV is the ESP32-S3 minimum supply voltage.

    config WATCH_SLEEP_SD_LINES_LOW
        bool "Hold the SD lines low in deep sleep (battery calibration load)"
        default n
        depends on WATCH_BATTERY_LOG
        help
            Battery run R: GPIO1, 2, 3 and 17 are driven low and held through
            deep sleep; a PWR key wake releases them. Each has a 10k pull-up to
            VCC3V3 and no card is fitted, so this adds a known load of about
            4 x 0.33 mA = 1.32 mA on VCC3V3. The change in the VBAT slope
            converts the slopes of the other runs into current without relying
            on the cell capacity.

    config WATCH_SLEEP_ISOLATE_USB_PADS
        bool "Isolate the USB pads in deep sleep (battery test)"
        default n
        depends on WATCH_BATTERY_LOG
        help
            Battery run S: GPIO19 and GPIO20 (USB D- and D+) have no pull on the
            board and float while USB is unplugged; ESP-IDF leaves these RTC pads
            as they are in deep sleep. They are isolated before deep sleep and
            given back to USB at the start of every wake.

    config WATCH_SLEEP_AXP_SLEEP_MODE
        bool "AXP2101 sleep mode in deep sleep (battery test)"
        default n
        depends on WATCH_BATTERY_LOG
        help
            Battery run T: the AXP2101 sleep mode (REG26 bit0) is switched on
            before deep sleep and off again at each wake, as LilyGo does on its
            watches. The datasheet does not say whether it lowers the PMU's own
            current. The rails stay as they are and the wakeup bit is never
            written.

    config WATCH_BATTERY_LOG
        bool "Battery drain log"
        default n
        help
            Wakes on a timer, stores battery voltage and gauge percentage in
            RTC memory and sleeps again at once. A PWR key wake prints the log.
            Used to estimate the average current without a meter.

    config WATCH_BATTERY_LOG_INTERVAL_MIN
        int "Battery log interval (minutes)"
        default 15
        depends on WATCH_BATTERY_LOG

    config WATCH_BATTERY_LOG_AOD
        bool "Show the always-on face during the battery log"
        default n
        depends on WATCH_BATTERY_LOG
        help
            After the awake window the always-on face runs (set
            WATCH_MOTION_OFF_MIN to 0 to keep it on), and one of its minute
            wakes per logging interval records the battery.

    config WATCH_MOTION_LOG
        bool "Motion measurement log"
        default n
        help
            Every always-on minute wake takes one accelerometer reading
            (average of 8 samples) and keeps it in RTC memory; a PWR wake
            prints the log. Used to choose the no-motion threshold and to
            measure how long one reading keeps the watch awake
            (docs/hardware.md, open question 3).

endmenu
```
